## conf/bblayers.conf.sample
```bitbake
# POKY_BBLAYERS_CONF_VERSION is increased each time build/conf/bblayers.conf
# changes incompatibly
POKY_BBLAYERS_CONF_VERSION = "2"

BBPATH = "${TOPDIR}"
BBFILES ?= ""

BBLAYERS ?= " \
  ##OEROOT##/meta \
  ##OEROOT##/meta-poky \
  ##OEROOT##/../meta-arm/meta-arm \
  ##OEROOT##/../meta-mediatek-bsp \
  ##OEROOT##/../meta-rity/meta \
  ##OEROOT##/../meta-rity/meta-rity-bringup \
  ##OEROOT##/../meta-rity/meta-rity-demo \
  ##OEROOT##/../meta-qt5 \
  ##OEROOT##/../meta-nn \
  ##OEROOT##/../meta-tensorflow \
  "
```

## conf/layer.conf
```bitbake
# We have a conf and classes directory, add to BBPATH
BBPATH .= ":${LAYERDIR}"

# We have recipes-* directories, add to BBFILES
BBFILES += "${LAYERDIR}/recipes-*/*.bb ${LAYERDIR}/recipes-*/*/*.bb ${LAYERDIR}/recipes-*/*/*.bbappend ${LAYERDIR}/recipes-*/*/*/*.bb ${LAYERDIR}/recipes-*/*/*/*.bbappend"

BBFILE_COLLECTIONS += "nn"
BBFILE_PATTERN_nn = "^${LAYERDIR}/"
BBFILE_PRIORITY_nn = "7"

# This should only be incremented on significant changes that will
# cause compatibility issues with other layers
LAYERVERSION_nn = "1"

LAYERDEPENDS_nn = " \
	core \
"

LAYERSERIES_COMPAT_nn = " kirkstone "

TFLITE_PREBUILT ??= "1"
DISTRO_FEATURES:append = " ${@bb.utils.contains("TFLITE_PREBUILT", "1", "tflite-prebuilt", "tflite", d)}"
```
